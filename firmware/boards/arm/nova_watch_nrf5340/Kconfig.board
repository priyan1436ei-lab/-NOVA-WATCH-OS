## firmware/boards/arm/nova_watch_nrf5340/Kconfig.board
```kconfig
# NOVA WATCH OS Board Configuration

config BOARD_NOVA_WATCH_NRF5340_CPUAPP
    bool "NOVA Watch nRF5340 Application Core"
    depends on SOC_NRF5340_CPUAPP_QKAA
    select SOC_DCDC_NRF53X_APP
    select SOC_DCDC_NRF53X_NET
    select SOC_DCDC_NRF53X_HV

config BOARD_NOVA_WATCH_NRF5340_CPUNET
    bool "NOVA Watch nRF5340 Network Core"
    depends on SOC_NRF5340_CPUNET_QKAA
```

## firmware/boards/arm/nova_watch_nrf5340/Kconfig.defconfig
```kconfig
# NOVA Watch nRF5340 Default Config

if BOARD_NOVA_WATCH_NRF5340_CPUAPP

config BOARD
    default "nova_watch_nrf5340_cpuapp"

config BT_CTLR
    default n

endif # BOARD_NOVA_WATCH_NRF5340_CPUAPP

if BOARD_NOVA_WATCH_NRF5340_CPUNET

config BOARD
    default "nova_watch_nrf5340_cpunet"

config BT_CTLR
    default y

endif # BOARD_NOVA_WATCH_NRF5340_CPUNET
```

## firmware/boards/arm/nova_watch_nrf5340/nova_watch_nrf5340_cpuapp_defconfig
```kconfig
CONFIG_SOC_SERIES_NRF53X=y
CONFIG_SOC_NRF5340_CPUAPP_QKAA=y
CONFIG_BOARD_NOVA_WATCH_NRF5340_CPUAPP=y

CONFIG_GPIO=y
CONFIG_I2C=y
CONFIG_SPI=y
CONFIG_NORDIC_QSPI_NOR=y

CONFIG_CONSOLE=y
CONFIG_UART_CONSOLE=y
CONFIG_SERIAL=y
```

## firmware/boards/arm/nova_watch_nrf5340/nova_watch_nrf5340_cpunet_defconfig
```kconfig
CONFIG_SOC_SERIES_NRF53X=y
CONFIG_SOC_NRF5340_CPUNET_QKAA=y
CONFIG_BOARD_NOVA_WATCH_NRF5340_CPUNET=y

CONFIG_BT=y
CONFIG_BT_HCI_RAW=y
CONFIG_BT_CTLR=y
CONFIG_BT_LL_SW_SPLIT=y
```
